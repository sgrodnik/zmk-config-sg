## config/boards/shields/sg1/Kconfig.defconfig
```kconfig
if SHIELD_SG1

config ZMK_KEYBOARD_NAME
    default "sg1"

config BT_DEVICE_NAME
    default "sg1"

endif
```

## config/west.yml
```yaml
manifest:
  remotes:
    # See https://docs.zephyrproject.org/3.2.0/develop/west/manifest.html#projects
    - name: zmkfirmware
      url-base: https://github.com/zmkfirmware
    - name: caksoylar
      url-base: https://github.com/caksoylar
    - name: urob
      url-base: https://github.com/urob
  projects:
    - name: zmk
      remote: zmkfirmware
      revision: going-modular
      import: app/west.yml
    - name: zmk-rgbled-widget
      remote: caksoylar
      revision: main
    - name: zmk-auto-layer
      remote: urob
      revision: main
  self:
    path: config
```
